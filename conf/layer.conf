## conf/layer.conf
```bitbake
# We have a conf and classes directory, add to BBPATH
BBPATH .= ":${LAYERDIR}"

# We have recipes-* directories, add to BBFILES
BBFILES += "${LAYERDIR}/recipes-*/*/*.bb \
            ${LAYERDIR}/recipes-*/*/*.bbappend"

BBFILE_COLLECTIONS += "meta-infotainment"
BBFILE_PATTERN_meta-infotainment = "^${LAYERDIR}/"
BBFILE_PRIORITY_meta-infotainment = "15"

LAYERDEPENDS_meta-infotainment = "core"
LAYERSERIES_COMPAT_meta-infotainment = "kirkstone"
```
